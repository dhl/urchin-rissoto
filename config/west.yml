## config/west.yml
```yaml
manifest:
  remotes:
    # zmk official
    - name: zmkfirmware
      url-base: https://github.com/zmkfirmware
      # bravekarma
    - name: caksoylar
      url-base: https://github.com/caksoylar
      # kyek / duckyb
    - name: duckyb
      url-base: https://github.com/duckyb
      # nice-view-gem
    - name: m165437
      url-base: https://github.com/M165437
  projects:
    - name: zmk
      remote: zmkfirmware
      revision: edf5c0814fd3ea202e43aad2d68fd32e882a518c # v0.3.0
      import: app/west.yml
    - name: urchin-zmk-module
      remote: duckyb
      revision: a3ab64fa7779f82675695f3d7d17f705f840da25 # main
    - name: nice-view-gem
      remote: m165437
      revision: 7794ebf7f75d7e16cb05240bcffe6c5a45ef5b44 # v0.3.0
  self:
    path: config
```
